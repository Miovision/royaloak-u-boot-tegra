## board/miovision/royaloak-ctm/Kconfig
```kconfig
# Copyright (c) 2020, Miovision.
# Miovision Technologies Inc.
#
# SPDX-License-Identifier: GPL-2.0

if TARGET_ROYALOAK_CTM

config SYS_BOARD
	default "royaloak-ctm"

config SYS_VENDOR
	default "miovision"

config SYS_CONFIG_NAME
	default "royaloak-ctm"

config P3450_EMMC
	bool "SKU 2 module with eMMC"

endif
```

## board/miovision/royaloak-smartsense/Kconfig
```kconfig
# Copyright (c) 2020, Miovision.
# Miovision Technologies Inc.
#
# SPDX-License-Identifier: GPL-2.0

if TARGET_ROYALOAK_SMARTSENSE

config SYS_BOARD
	default "royaloak-smartsense"

config SYS_VENDOR
	default "miovision"

config SYS_CONFIG_NAME
	default "royaloak-smartsense"

endif
```

## board/miovision/smartsense/Kconfig
```kconfig
# Copyright (c) 2020, Miovision.
#
# SPDX-License-Identifier: GPL-2.0

if TARGET_SMARTSENSE

config SYS_BOARD
	default "smartsense"

config SYS_VENDOR
	default "miovision"

config SYS_CONFIG_NAME
	default "smartsense"

endif
```
